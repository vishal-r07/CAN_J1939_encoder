VERSION ""

NS_ :

BS_:

BU_: Controller

BO_ 2364539904 EEC1: 8 Controller
 SG_ Engine_Speed : 24|16@1+ (0.125,0) [0|8031.875] "rpm" Vector__XXX

BO_ 2364539648 EEC2: 8 Controller
 SG_ Accel_Pedal_Pos : 8|8@1+ (0.4,0) [0|100] "%" Vector__XXX

BO_ 2566844672 CCVS1: 8 Controller
 SG_ Vehicle_Speed : 8|16@1+ (0.00390625,0) [0|250.996] "km/h" Vector__XXX

BO_ 2566844928 LFE: 8 Controller
 SG_ Engine_Fuel_Rate : 0|16@1+ (0.05,0) [0|3212.75] "L/h" Vector__XXX
 SG_ Engine_Inst_Fuel_Economy : 16|16@1+ (0.001953125,0) [0|127.998] "km/L" Vector__XXX

CM_ BO_ 2364539904 "Electronic Engine Controller 1 (PGN 61444 / 0xF004) - cycle 50 ms.";
CM_ SG_ 2364539904 Engine_Speed "Engine Speed (SPN 190)";
CM_ BO_ 2364539648 "Electronic Engine Controller 2 (PGN 61443 / 0xF003) - cycle 50 ms.";
CM_ SG_ 2364539648 Accel_Pedal_Pos "Accelerator Pedal Position 1 (SPN 91)";
CM_ BO_ 2566844672 "Cruise Control/Vehicle Speed 1 (PGN 65265 / 0xFEF1) - cycle 50 ms.";
CM_ SG_ 2566844672 Vehicle_Speed "Wheel-Based Vehicle Speed (SPN 84)";
CM_ BO_ 2566844928 "Fuel Economy Liquid (PGN 65266 / 0xFEF2) - cycle 50 ms.";
CM_ SG_ 2566844928 Engine_Fuel_Rate "Engine Fuel Rate (SPN 183)";
CM_ SG_ 2566844928 Engine_Inst_Fuel_Economy "Engine Instantaneous Fuel Economy (SPN 184)";

BA_DEF_  "BusType" STRING ;
BA_DEF_  "ProtocolType" STRING ;
BA_DEF_ BO_  "VFrameFormat" ENUM  "StandardCAN","ExtendedCAN","reserved","J1939PG";
BA_DEF_ BO_  "GenMsgCycleTime" INT 0 3600000;
BA_DEF_ BO_  "PGN" INT 0 262143;
BA_DEF_ SG_  "SPN" INT 0 524287;

BA_DEF_DEF_  "BusType" "CAN";
BA_DEF_DEF_  "ProtocolType" "J1939";
BA_DEF_DEF_  "VFrameFormat" "J1939PG";
BA_DEF_DEF_  "GenMsgCycleTime" 50;
BA_DEF_DEF_  "PGN" 61444;
BA_DEF_DEF_  "SPN" 190;

BA_ "PGN" BO_ 2364539648 61443;
BA_ "SPN" SG_ 2364539648 Accel_Pedal_Pos 91;

BA_ "PGN" BO_ 2566844672 65265;
BA_ "SPN" SG_ 2566844672 Vehicle_Speed 84;

BA_ "PGN" BO_ 2566844928 65266;
BA_ "SPN" SG_ 2566844928 Engine_Fuel_Rate 183;
BA_ "SPN" SG_ 2566844928 Engine_Inst_Fuel_Economy 184;
